# file: hoa.ioc
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Mcu.Family=STM32F4
Mcu.Name=STM32F411V(C-E)Tx
Mcu.Package=LQFP100
NVIC.PriorityGroup=NVIC_PRIORITYGROUP_4
PA13.Mode=Serial_Wire
PA13.Signal=SYS_JTMS-SWDIO
PA14.Mode=Serial_Wire
PA14.Signal=SYS_JTCK-SWCLK
ProjectManager.HeapSize=0x200
ProjectManager.StackSize=0x400
ProjectManager.TargetToolchain=STM32CubeIDE
RCC.AHBFreq_Value=16000000
RCC.APB1Freq_Value=16000000
RCC.APB2Freq_Value=16000000
RCC.CortexFreq_Value=16000000
RCC.HSE_VALUE=25000000
RCC.HSI_VALUE=16000000
RCC.LSE_VALUE=32768
RCC.SYSCLKFreq_VALUE=16000000
RCC.VCOOutputFreq_Value=192000000
board=custom

// file: Core/Src/main.c
/* USER CODE BEGIN Header */
/**
  ******************************************************************************
  * @file           : main.c
  * @brief          : Main program body
  ******************************************************************************
  * @attention
  *
  * Copyright (c) 2023 STMicroelectronics.
  * All rights reserved.
  *
  * This software is licensed under terms that can be found in the LICENSE file
  * in the root directory of this software component.
  * If no LICENSE file comes with this software, it is provided AS-IS.
  *
  ******************************************************************************
  */
/* USER CODE END Header */
#include "main.h"

void SystemClock_Config(void);
static void MX_GPIO_Init(void);

/* USER CODE BEGIN 0 */
#define WHO_AM_I 0x0F
uint8_t Sensor_ID;// bien toan cuc khong khoi tao ban dau
void I2C_init()
{
	__HAL_RCC_GPIOB_CLK_ENABLE();
	uint32_t* GPIOB_MODER = (uint32_t*)0x40020400;
	*GPIOB_MODER &= ~(0b11 << 18);
	*GPIOB_MODER &= ~(0b11 << 12);
	*GPIOB_MODER |= (0b10 << 12)|(0b10 << 18);

	uint32_t* GPIOB_PUPDR = (uint32_t*)0x4002040c;
	*GPIOB_PUPDR &= ~(0b11 << 12);
	*GPIOB_PUPDR &= ~(0b11 << 18);
	*GPIOB_PUPDR |= (0b01 << 12)|(0b01 << 18);

	uint32_t* GPIOB_AFRL = (uint32_t*)0x40020420;
	*GPIOB_AFRL &= ~(0xf << 24);
	*GPIOB_AFRL |= (4 << 24);

	uint32_t* GPIOB_AFRH = (uint32_t*)0x40020424;
	*GPIOB_AFRH &= ~(0xf << 4);
	*GPIOB_AFRH |= (4 << 4);

	__HAL_RCC_I2C1_CLK_ENABLE();
	uint32_t* I2C1_CR1 = (uint32_t*)0x40005400;
	*I2C1_CR1 &= ~(1);
	uint32_t* I2C1_CR2 = (uint32_t*)0x40005404;
	*I2C1_CR2 |= 16;
	uint32_t* I2C1_CCR = (uint32_t*)0x4000541c;
	*I2C1_CCR = 80;
	*I2C1_CR1 |= (1);
}
uint8_t I2C_Sensor_Read(uint8_t adr, uint8_t data)
{
	uint32_t* I2C1_CR1 = (uint32_t*)0x40005400;
	uint32_t* I2C1_SR1 = (uint32_t*)0x40005414;
	uint32_t* I2C1_SR2 = (uint32_t*)0x40005418;
	uint32_t* I2C1_DR = (uint32_t*)0x40005410;

	const uint8_t address = (adr << 1);
	while(((*I2C1_SR2 >> 1) & 1) == 1);

	*I2C1_CR1 |= (1 << 8);
	while(((*I2C1_SR1 >> 0) & 1) != 1);
	*I2C1_DR = address | 0;
	while(((*I2C1_SR1 >> 1) & 1) != 1);
	uint32_t temp = *I2C1_SR2;
	*I2C1_DR = data;
	while(((*I2C1_SR1 >> 2) & 1) != 1);
	while(((*I2C1_SR1 >> 10) & 1) == 1);

	*I2C1_CR1 |= (1 << 8);
	while(((*I2C1_SR1 >> 0) & 1) != 1);
	*I2C1_DR = address | 1;
	while(((*I2C1_SR1 >> 1) & 1) != 1);
	temp = *I2C1_SR2;

	uint8_t default_data = *I2C1_DR;
	*I2C1_CR1 |= (1 << 9);
	return default_data;
}
/* USER CODE END 0 */

int main(void)
{

  /* MCU Configuration--------------------------------------------------------*/

  /* Reset of all peripherals, Initializes the Flash interface and the Systick. */
  HAL_Init(); // chạy rui do ban tui oi
  I2C_init(); // khong co cai nay lam gi co clock ma chay
  // nho cai nay cho minh voi
  //ong rui nha
  //I2C_init();

  /* Configure the system clock */
  SystemClock_Config();

  /* Initialize all configured peripherals */
  MX_GPIO_Init();
  /* USER CODE BEGIN 2 */

  Sensor_ID = I2C_Sensor_Read(0b0011001, WHO_AM_I);
  HAL_Delay(1000);
  /* USER CODE END 2 */

  /* Infinite loop */
  /* USER CODE BEGIN WHILE */
  while (1)
  {
	  //Sensor_ID = I2C_Sensor_Read(0b0011001, WHO_AM_I);
    /* USER CODE END WHILE */

  }
}

void SystemClock_Config(void)
{
  RCC_OscInitTypeDef RCC_OscInitStruct = {0};
  RCC_ClkInitTypeDef RCC_ClkInitStruct = {0};

  /** Configure the main internal regulator output voltage
  */
  __HAL_RCC_PWR_CLK_ENABLE();
  __HAL_PWR_VOLTAGESCALING_CONFIG(PWR_REGULATOR_VOLTAGE_SCALE1);

  /** Initializes the RCC Oscillators according to the specified parameters
  * in the RCC_OscInitTypeDef structure.
  */
  RCC_OscInitStruct.OscillatorType = RCC_OSCILLATORTYPE_HSI;
  RCC_OscInitStruct.HSIState = RCC_HSI_ON;
  RCC_OscInitStruct.HSICalibrationValue = RCC_HSICALIBRATION_DEFAULT;
  RCC_OscInitStruct.PLL.PLLState = RCC_PLL_NONE;
  if (HAL_RCC_OscConfig(&RCC_OscInitStruct) != HAL_OK)
  {
    Error_Handler();
  }

  /** Initializes the CPU, AHB and APB buses clocks
  */
  RCC_ClkInitStruct.ClockType = RCC_CLOCKTYPE_HCLK|RCC_CLOCKTYPE_SYSCLK
                              |RCC_CLOCKTYPE_PCLK1|RCC_CLOCKTYPE_PCLK2;
  RCC_ClkInitStruct.SYSCLKSource = RCC_SYSCLKSOURCE_HSI;
  RCC_ClkInitStruct.AHBCLKDivider = RCC_SYSCLK_DIV1;
  RCC_ClkInitStruct.APB1CLKDivider = RCC_HCLK_DIV1;
  RCC_ClkInitStruct.APB2CLKDivider = RCC_HCLK_DIV1;

  if (HAL_RCC_ClockConfig(&RCC_ClkInitStruct, FLASH_LATENCY_0) != HAL_OK)
  {
    Error_Handler();
  }
}

static void MX_GPIO_Init(void)
{

  /* GPIO Ports Clock Enable */
  __HAL_RCC_GPIOA_CLK_ENABLE();

}

void Error_Handler(void)
{
  __disable_irq();
  while (1)
  {
  }
}
